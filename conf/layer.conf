## conf/layer.conf
```bitbake
# We have a conf and classes directory, add to BBPATH
BBPATH .= ":${LAYERDIR}"

# We have recipes-* directories, add to BBFILES
BBFILES += "${LAYERDIR}/recipes-*/*/*.bb \
            ${LAYERDIR}/recipes-*/*/*.bbappend"

BBFILE_COLLECTIONS += "meta-example-yocto"
BBFILE_PATTERN_meta-example-yocto = "^${LAYERDIR}/"
BBFILE_PRIORITY_meta-example-yocto = "6"

LAYERDEPENDS_meta-example-yocto = "core"
LAYERSERIES_COMPAT_meta-example-yocto = "warrior zeus"
```
